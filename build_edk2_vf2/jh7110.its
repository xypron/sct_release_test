## build_edk2_vf2/jh7110.its
```
/dts-v1/;

/ {
    description = "EDK II for StarFive VisionFive 2";

    images {
        edk2 {
            description = "EDK II for StarFive VisionFive 2";
            data = /incbin/("JH7110.fd");
            type = "firmware";
            os = "u-boot";
            arch = "riscv";
            compression = "none";
            load = <0x0 0x40000000>;
            entry = <0x0 0x40000000>;
        };
    };
    configurations {
        default = "config_1";

        config_1 {
            description = "EDK II for StarFive VisionFive 2";
            firmware = "edk2";
        };
    };
};
```
